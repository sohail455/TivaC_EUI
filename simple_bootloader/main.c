#include <stdint.h>
#include "stdbool.h"
#include "inc/hw_types.h"
#include "inc/hw_memmap.h"
#include "driverlib/fpu.h"
#include "driverlib/gpio.h"
#include "driverlib/pin_map.h"
#include "driverlib/flash.h"
#include "driverlib/sysctl.h"
#include "driverlib/eeprom.h"

#define FLASH_BLOCK_ADDR   0x00010000
#define NUMBER_OF_SECTORS  2
#define FLASHING_REQUEST   0xAAAAAAAA
#define EEPROM_CLEAR        0x00000000
#define FLAG_ADDRESS       0x400
#define FLASH_BLOCK        0x400

uint32_t ptr=0;
typedef void (*p_fun)(void);
p_fun jump;
uint32_t pui32Data=FLASHING_REQUEST;
uint32_t pui32Read=0;

const uint8_t new_image[] = {
                                   0x00,
                                   0x02,
                                   0x00,
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                                   0xfe,
                                   0xe7
};


int main(void)
{
    //Enable system clock
    SysCtlClockSet(SYSCTL_SYSDIV_4 | SYSCTL_USE_PLL | SYSCTL_OSC_MAIN | SYSCTL_XTAL_16MHZ);
    // Enable the EEPROM0 peripheral
    SysCtlPeripheralEnable(SYSCTL_PERIPH_EEPROM0);
    while(!SysCtlPeripheralReady(SYSCTL_PERIPH_EEPROM0))
    {
    }
    // Initialise EEPROM
    EEPROMInit();
    // Read The flag from EEPROM
    EEPROMRead(&pui32Read, FLAG_ADDRESS, sizeof(pui32Read));
    // check the flag from EEPROM
    if(pui32Read == FLASHING_REQUEST)
    {
        //erase Flash before Flashing
        pui32Data = EEPROM_CLEAR;
        EEPROMProgram(&pui32Data, FLAG_ADDRESS, sizeof(pui32Data));
        uint8_t sector_counter=0;
        for(sector_counter=0; sector_counter < NUMBER_OF_SECTORS; sector_counter++)
        {
            FlashErase(FLASH_BLOCK_ADDR+sector_counter*(FLASH_BLOCK));
        }
        // Flash the data
        FlashProgram((uint32_t *)new_image, FLASH_BLOCK_ADDR, sizeof(new_image));
        ptr = *( uint32_t *)(FLASH_BLOCK_ADDR + 4);
        jump = (p_fun)ptr;
        __set_MSP(*(( uint32_t *)FLASH_BLOCK_ADDR));
        jump();
    }
    else
    {
        // Enable PORTF
        SysCtlPeripheralEnable(SYSCTL_PERIPH_GPIOF);
        // choose the configurations of pins
        GPIOPinTypeGPIOOutput(GPIO_PORTF_BASE, GPIO_PIN_2);
        GPIOPinTypeGPIOInput(GPIO_PORTF_BASE, GPIO_PIN_4);
        GPIOPadConfigSet(GPIO_PORTF_BASE, GPIO_PIN_4, GPIO_STRENGTH_2MA, GPIO_PIN_TYPE_STD_WPU);

        while(1)
        {
            // check the switch
            uint32_t switchStatus = GPIOPinRead(GPIO_PORTF_BASE, GPIO_PIN_4);
            if(switchStatus == 0)
            {
                EEPROMProgram(&pui32Data, FLAG_ADDRESS, sizeof(pui32Data));
                SysCtlReset();
            }
            // toggle the Blue led
            GPIOPinWrite(GPIO_PORTF_BASE, GPIO_PIN_2, GPIO_PIN_2);
            SysCtlDelay(2000000);
            GPIOPinWrite(GPIO_PORTF_BASE, GPIO_PIN_2, 0);
            SysCtlDelay(2000000);
        }

    }
}
